/*********************************************************
* File: lab3_main.h
*
* Description: This is a main function that creates tasks
*              using FreeRTOS to:
*			If SW7 is pressed:
*			o LED2 blinks at approximately 2 Hz (use a task)
*			o LED7 blinks at 7 Hz (using a Timer2 interrupt)
*			o LED6 is on
*
*			If SW7 is not pressed:
*			o LED2 blinks at approximately 4 Hz (use a task)
*			o LED7 blinks at 14Hz
*
*			Switches utilize pins on PORTE, and LEDs are
*			attached to PORTA of the STK600
*
* Author: Haleigh Vierra, Matt Cruse
*
* Revisions:
*   4/18/2013 HAV Original File Created
*   4/23/2013 HAV MAC changed clock frequency to 2MHz
*
**********************************************************/
//-------------------Library Includes--------------------//
#include <stdint.h>
#include <avr/io.h>
#include <avr/interrupt.h>
#include "FreeRTOS.h"
#include "task.h"
#include "init.h"
#include "semphr.h"

//----------------------Definitions----------------------//
#define F_CPU 2000000
#define DELAY_MS_1HZ 500
#define DELAY_MS_2HZ 250
#define DELAY_MS_4HZ 125
#define DELAY_MS_7HZ 71
#define DELAY_MS_8HZ 63
#define DELAY_MS_14HZ 36
#define DEBOUNCE_DELAY 20
#define LED2 2
#define LED6 6
#define LED7 7
//-----------------Function Prototypes-------------------//
void vTaskFunction_LEDToggle(void *target_led);
void vTaskFunction_buttonHandler(void *pvNada);
void vTaskFunction_timerHandler(void *pvNada);

//---------------------Structures------------------------//
/*-----------------------------------------------------
* Structure: LED
*
* Description: The LED struct is used to represent an LED
*              on the board. An LED has two properties:
*              1) the position of the LED on the output
*                 port.
*              2) the blinking frequency of the LED. This
*                 is represented by using the ms delay
*                 that will create the frequency.
*--------------------------------------------------------*/
typedef struct LED {
	int pos;
	int freq_delay;
}LED;

//----------------------Globals--------------------------//
// Creates a global LED.
LED led2 = {
	.pos = LED2,
	.freq_delay = DELAY_MS_4HZ
};

//Create Binary Semaphore for button interrupt handler
xSemaphoreHandle xBinarySemaphore_buttonPress;
//Create Binary Semaphore for timer interrupt handler
xSemaphoreHandle xBinarySemaphore_timer;

//-------------------Main Function-----------------------//
int main( void )
{  	
    // Function initializing PORTA as an output and setting LEDs low, set PORTE as input
	vIO_init(); 
	//Function initializing timer to to generate interrupts at 7Hz
	initialize_timer2();
	initialize_button_read();

	vSemaphoreCreateBinary( xBinarySemaphore_buttonPress );
	vSemaphoreCreateBinary( xBinarySemaphore_timer );
	
	// Creates a task to blink LED2
	xTaskCreate(vTaskFunction_LEDToggle, "LED2 Task", configMINIMAL_STACK_SIZE, (void *) &led2, 1, NULL );
	// Creates a handler task for the interrupt generated by SW7
	xTaskCreate(vTaskFunction_buttonHandler, "BTN Task", configMINIMAL_STACK_SIZE, NULL, 2, NULL );
	// Creates a handler task for the interrupt generated by Timer2 CTC
	xTaskCreate(vTaskFunction_timerHandler, "TMR Task", configMINIMAL_STACK_SIZE, NULL, 1, NULL );
	
    // Start the task scheduler
	vTaskStartScheduler();

	return 0;
}

//----------------Function Definitions-------------------//
/*-----------------------------------------------------
* Function: vTaskFunction_LEDToggle
*
* Description: This task function toggles a specified
*              LED at a specified frequency defined in
*              the array pointed to by 'target_led'
*
* param a: void *led: pointer to an LED structure. This
*          contains the information of which pin port the
*		   LED is connected and the delay needed to block
*		   the task to run at a desired frequency.
*
* return: void
*--------------------------------------------------------*/
void vTaskFunction_LEDToggle(void *target_led)
{
	// variable to hold ticks value of last task run
	portTickType xLastWakeTime;
	// pointer to the value that describes which LED to toggle
	LED *local_led = (LED *) target_led;
	
	// Initialize the xLastWakeTime variable with the current time.
	xLastWakeTime = xTaskGetTickCount();
	for (;;)
	{
		// toggle the LED pin
		PORTA ^= (1 << local_led->pos);
		
		// periodically run every 'LED_delay_ms' milliseconds
		vTaskDelayUntil(&xLastWakeTime, local_led->freq_delay / portTICK_RATE_MS);
	}
}

/*-----------------------------------------------------
* Function: vTaskFunction_buttonHandler
*
* Description: This task function is a handler for the
*              button press interrupt triggered by SW7.
*              It blocks for a millisecond period 
*			   determined by DEBOUNCE_DELAY, then checks
*			   whether the button is asserted or not
*			   and updates OCR2A, and toggles LED6 
*			   accordingly and updates LEDs run frequency.
*			   Re-enables button interrupts once done. 
*
* param a: void *pvNada: dummy variable
*
* return: void
*--------------------------------------------------------*/
void vTaskFunction_buttonHandler(void *pvNada)
{	
	for(;;)
	{
		xSemaphoreTake( xBinarySemaphore_buttonPress, portMAX_DELAY );
		// Block task for debounce of button
		vTaskDelay(DEBOUNCE_DELAY / portTICK_RATE_MS); 
		if(PINE & 0b10000000)// check if SW7 is asserted (active low)
		{
			PORTA |= (1 << LED6); //Turn LED6 off
			OCR2A = TIMER2_14Hz; // Set timer2 to blink LED7 at 14Hz
			led2.freq_delay = DELAY_MS_4HZ; // Set LED2 to blink at 4Hz
		}
		else // If it's asserted...
		{
			PORTA &= ~(1 << LED6); //Turn LED6 on
			OCR2A = TIMER2_7Hz; // Set timer2 to blink LED7 at 7Hz
			led2.freq_delay = DELAY_MS_2HZ; // Set LED2 to blink at 2Hz
		}
		EIMSK |= (1<<INT7); //re-enable external interrupt mask for button
	}
	
}

/*-----------------------------------------------------
* Function: vTaskFunction_timerHandler
*
* Description: This task function is a handler for the
*              timer2 interrupt.
*              It toggles LED7 and clears timer2 each 
*			   time it is given a semaphor from its
*			   respective ISR.
*
* param a: void *pvNada: dummy variable
*
* return: void
*--------------------------------------------------------*/
void vTaskFunction_timerHandler(void *pvNada)
{
	for(;;)
	{
		// Block until the timer semaphore is given to handler
		xSemaphoreTake( xBinarySemaphore_timer, portMAX_DELAY );
		PORTA ^= (1 << LED7);//Toggle LED7
		TCNT2 = 0;// reset timer2 count
	}
}

/*-----------------------------------------------------
* Function: ISR for timer2
*
* Description: This Interrupt Service Routine toggles 
*              LED7 and clears timer2's count.
*
* param a: TIMER2_COMPA_vect: vector generated when
*		   timer2 reaches the value held be OCR2A
*--------------------------------------------------------*/
ISR(TIMER2_COMPA_vect)
{
	static portBASE_TYPE xHigherPriorityTaskWoken;
	xHigherPriorityTaskWoken = pdFALSE;
	/* 'Give' the semaphore to unblock the task. */
	xSemaphoreGiveFromISR( xBinarySemaphore_timer, &xHigherPriorityTaskWoken );
	// perform context switch if handler is of higher priority
	if( xHigherPriorityTaskWoken == pdTRUE )
	{
		vPortYield();
	}
}


/*-----------------------------------------------------
* Function: ISR for SW7 press
*
* Description: This Interrupt Service Routine checks if
*              SW7 is pressed, then toggles LED7 and
*              clears timer2's count in its handler.
*
* param a: INT7_vect: vector generated when
*		   a logic level change on pin E7 occurs
*--------------------------------------------------------*/
ISR(INT7_vect)
{
	EIMSK &= ~(1<<INT7);//disable external interrupt mask
	EIFR &= (1 << INTF7); //clear the interrupt flag, just in case debounce queued another vector
	
	static portBASE_TYPE xHigherPriorityTaskWoken;
	xHigherPriorityTaskWoken = pdFALSE;
	/* 'Give' the semaphore to unblock the task. */
	xSemaphoreGiveFromISR( xBinarySemaphore_buttonPress, &xHigherPriorityTaskWoken );
	// perform context switch if handler is higher priority
	if( xHigherPriorityTaskWoken == pdTRUE )
	{
		vPortYield();
	}		
}
